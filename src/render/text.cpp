/**
 * text.cpp — Series 40 bitmap fonts for menus and screens (generated by tools/gen_fonts.py).
 *
 * Small font: proportional, 13-row frame (ascender top row 0, caps rows 1..9, x-height
 * rows 3..9, descenders to row 12), 1 px gap between glyphs; one byte per row, leftmost
 * pixel in the most significant of `w` bits.  `y` is the frame's top row.
 * Big font: the bold list font, 15-row frame (caps rows 1..11), two bytes per row.
 */
#include "render/text.h"
#include "drivers/st7735.h"

#include <avr/pgmspace.h>

#include "render/smallfont.inc"

#define SMALL_H        13
#define SMALL_GAP      1
#define SMALL_SPACE_W  3

static int8_t small_index(char c) {
    for (uint8_t i = 0; SMALL_CHARS[i]; i++)
        if (SMALL_CHARS[i] == c) return (int8_t)i;
    return -1;                     /* space and unsupported characters */
}

static uint8_t small_advance(char c, uint8_t scale) {
    int8_t i = small_index(c);
    return (uint8_t)(((i < 0 ? SMALL_SPACE_W : SMALL_W[i]) + SMALL_GAP) * scale);
}

static void draw_small_glyph(int8_t i, uint8_t x, uint8_t y, uint8_t scale, uint16_t color) {
    uint8_t w = SMALL_W[i];
    for (uint8_t row = 0; row < SMALL_H; row++) {
        uint8_t bits = pgm_read_byte(&SMALL_ROWS[i][row]);
        uint8_t col = 0;
        while (col < w) {                          /* one fill per horizontal run */
            if (!(bits & (1 << (w - 1 - col)))) { col++; continue; }
            uint8_t start = col;
            while (col < w && (bits & (1 << (w - 1 - col)))) col++;
            st7735_fill_rect((uint8_t)(x + start * scale), (uint8_t)(y + row * scale),
                             (uint8_t)((col - start) * scale), scale, color);
        }
    }
}

void text_draw(uint8_t x, uint8_t y, const char *txt,
               uint8_t scale, uint16_t color) {
    if (!txt || scale == 0) return;
    uint8_t cx = x;
    for (const char *p = txt; *p; p++) {
        int8_t i = small_index(*p);
        if (i >= 0) draw_small_glyph(i, cx, y, scale, color);
        cx = (uint8_t)(cx + small_advance(*p, scale));
    }
}

void text_draw_p(uint8_t x, uint8_t y, const char *txt_p,
                 uint8_t scale, uint16_t color) {
    if (!txt_p || scale == 0) return;
    uint8_t cx = x;
    for (const char *p = txt_p; pgm_read_byte(p); p++) {
        char c = (char)pgm_read_byte(p);
        int8_t i = small_index(c);
        if (i >= 0) draw_small_glyph(i, cx, y, scale, color);
        cx = (uint8_t)(cx + small_advance(c, scale));
    }
}

uint8_t text_width(const char *txt, uint8_t scale) {
    if (!txt || scale == 0 || !*txt) return 0;
    uint8_t w = 0;
    for (const char *p = txt; *p; p++) w = (uint8_t)(w + small_advance(*p, scale));
    return (uint8_t)(w - SMALL_GAP * scale);
}

uint8_t text_width_p(const char *txt_p, uint8_t scale) {
    if (!txt_p || scale == 0 || !pgm_read_byte(txt_p)) return 0;
    uint8_t w = 0;
    for (const char *p = txt_p; pgm_read_byte(p); p++)
        w = (uint8_t)(w + small_advance((char)pgm_read_byte(p), scale));
    return (uint8_t)(w - SMALL_GAP * scale);
}


/* ── Bold list font (S40-style list items and soft key) ───────────────────── */

#include "render/bigfont.inc"

#define BIG_H        15
#define BIG_GAP      1
#define BIG_SPACE_W  4

static int8_t big_index(char c) {
    for (uint8_t i = 0; BIG_CHARS[i]; i++)
        if (BIG_CHARS[i] == c) return (int8_t)i;
    return -1;                     /* space and unsupported characters */
}

uint8_t text_width_big(const char *txt) {
    if (!txt || !*txt) return 0;
    uint8_t w = 0;
    for (const char *p = txt; *p; p++) {
        int8_t i = big_index(*p);
        w = (uint8_t)(w + (i < 0 ? BIG_SPACE_W : BIG_W[i]) + BIG_GAP);
    }
    return (uint8_t)(w - BIG_GAP);
}

void text_draw_big(uint8_t x, uint8_t y, const char *txt, uint16_t color) {
    if (!txt) return;
    uint8_t cx = x;
    for (const char *p = txt; *p; p++) {
        int8_t i = big_index(*p);
        if (i < 0) { cx = (uint8_t)(cx + BIG_SPACE_W + BIG_GAP); continue; }
        uint8_t w = BIG_W[i];
        for (uint8_t row = 0; row < BIG_H; row++) {
            uint16_t bits = pgm_read_word(&BIG_ROWS[i][row]);
            uint8_t col = 0;
            while (col < w) {                      /* one fill per horizontal run */
                if (!(bits & (1 << (w - 1 - col)))) { col++; continue; }
                uint8_t start = col;
                while (col < w && (bits & (1 << (w - 1 - col)))) col++;
                st7735_fill_rect((uint8_t)(cx + start), (uint8_t)(y + row),
                                 (uint8_t)(col - start), 1, color);
            }
        }
        cx = (uint8_t)(cx + w + BIG_GAP);
    }
}
