/* GENERATED by tools/gen_fonts.py — do not edit. */
/* bold list font, 15 rows, rows are bitmaps */
/* chars: -.0123456789ABCDEFGHIMNOSTVWabcdefghiklmnopqrstuvwxyz */
static const char BIG_CHARS[] = "-.0123456789ABCDEFGHIMNOSTVWabcdefghiklmnopqrstuvwxyz";
static const uint8_t BIG_W[] = {4, 2, 7, 4, 7, 7, 7, 7, 7, 7, 7, 7, 7,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 7, 7};
static const uint16_t BIG_ROWS[][15] PROGMEM = {
    /* - */ {0x0000, 0x0000, 0x0000, 0x0000, 0x0000, 0x0000, 0x000E, 0x000F, 0x0000, 0x0000, 0x0000, 0x0000, 0x0000, 0x0000, 0x0000},
    /* . */ {0x0000, 0x0000, 0x0000, 0x0000, 0x0000, 0x0000, 0x0000, 0x0000, 0x0000, 0x0000, 0x0003, 0x0003, 0x0000, 0x0000, 0x0000},
    /* 0 */ {0x0000, 0x003E, 0x0063, 0x0063, 0x0063, 0x0063, 0x0063, 0x0063, 0x0063, 0x0063, 0x0063, 0x003E, 0x0000, 0x0000, 0x0000},
    /* 1 */ {0x0000, 0x0003, 0x0007, 0x000F, 0x0003, 0x0003, 0x0003, 0x0003, 0x0003, 0x0003, 0x0003, 0x0003, 0x0000, 0x0000, 0x0000},
    /* 2 */ {0x0000, 0x003E, 0x0063, 0x0003, 0x0003, 0x0006, 0x000C, 0x0018, 0x0030, 0x0060, 0x0060, 0x007F, 0x0000, 0x0000, 0x0000},
    /* 3 */ {0x0000, 0x003E, 0x0063, 0x0003, 0x0003, 0x001E, 0x0003, 0x0003, 0x0003, 0x0003, 0x0063, 0x003E, 0x0000, 0x0000, 0x0000},
    /* 4 */ {0x0000, 0x0006, 0x000E, 0x001E, 0x0036, 0x0066, 0x007F, 0x0006, 0x0006, 0x0006, 0x0006, 0x0006, 0x0000, 0x0000, 0x0000},
    /* 5 */ {0x0000, 0x007F, 0x0060, 0x0060, 0x007E, 0x0003, 0x0003, 0x0003, 0x0003, 0x0003, 0x0063, 0x003E, 0x0000, 0x0000, 0x0000},
    /* 6 */ {0x0000, 0x003E, 0x0060, 0x0060, 0x007E, 0x0063, 0x0063, 0x0063, 0x0063, 0x0063, 0x0063, 0x003E, 0x0000, 0x0000, 0x0000},
    /* 7 */ {0x0000, 0x007F, 0x0003, 0x0003, 0x0006, 0x0006, 0x000C, 0x000C, 0x0018, 0x0018, 0x0018, 0x0018, 0x0000, 0x0000, 0x0000},
    /* 8 */ {0x0000, 0x003E, 0x0063, 0x0063, 0x0063, 0x003E, 0x0063, 0x0063, 0x0063, 0x0063, 0x0063, 0x003E, 0x0000, 0x0000, 0x0000},
    /* 9 */ {0x0000, 0x003E, 0x0063, 0x0063, 0x0063, 0x003F, 0x0003, 0x0003, 0x0003, 0x0003, 0x0063, 0x003E, 0x0000, 0x0000, 0x0000},
    /* A */ {0x0000, 0x001C, 0x003E, 0x0063, 0x0063, 0x0063, 0x0063, 0x007F, 0x0067, 0x0063, 0x0063, 0x0063, 0x0000, 0x0000, 0x0000},
    /* B */ {0x0000, 0x007E, 0x0063, 0x0063, 0x0063, 0x0063, 0x007E, 0x0063, 0x0063, 0x0063, 0x0063, 0x007E, 0x0000, 0x0000, 0x0000},
    /* C */ {0x000F, 0x0010, 0x0030, 0x0030, 0x0030, 0x0030, 0x0030, 0x0030, 0x0030, 0x0030, 0x001C, 0x000F, 0x0000, 0x0000, 0x0000},
    /* D */ {0x0000, 0x00FC, 0x00C6, 0x00C3, 0x00C3, 0x00C3, 0x00C3, 0x00C3, 0x00C3, 0x00C3, 0x00C2, 0x00FC, 0x0000, 0x0000, 0x0000},
    /* E */ {0x0000, 0x003F, 0x0030, 0x0030, 0x0030, 0x0030, 0x003F, 0x0030, 0x0030, 0x0030, 0x0030, 0x003F, 0x0000, 0x0000, 0x0000},
    /* F */ {0x0000, 0x003F, 0x0030, 0x0030, 0x0030, 0x0030, 0x003F, 0x0030, 0x0030, 0x0030, 0x0030, 0x0030, 0x0000, 0x0000, 0x0000},
    /* G */ {0x0000, 0x003F, 0x0060, 0x0060, 0x0060, 0x0060, 0x0066, 0x0063, 0x0063, 0x0063, 0x0063, 0x003D, 0x0000, 0x0000, 0x0000},
    /* H */ {0x0000, 0x00C3, 0x00C3, 0x00C3, 0x00C3, 0x00C3, 0x00FF, 0x00FF, 0x00C3, 0x00C3, 0x00C3, 0x00C3, 0x0000, 0x0000, 0x0000},
    /* I */ {0x0000, 0x000F, 0x0006, 0x0006, 0x0006, 0x0006, 0x0006, 0x0006, 0x0006, 0x0006, 0x0006, 0x000F, 0x0000, 0x0000, 0x0000},
    /* M */ {0x0000, 0x0183, 0x01C7, 0x01C7, 0x01AB, 0x01AB, 0x0193, 0x0193, 0x0183, 0x0183, 0x0183, 0x0183, 0x0000, 0x0000, 0x0000},
    /* N */ {0x0000, 0x0003, 0x00C3, 0x00E3, 0x00F3, 0x00F3, 0x00DB, 0x00CB, 0x00CF, 0x00C7, 0x00C3, 0x00C1, 0x0000, 0x0000, 0x0000},
    /* O */ {0x0000, 0x007E, 0x00C3, 0x00C3, 0x00C3, 0x00C3, 0x00C3, 0x00C3, 0x00C3, 0x00C3, 0x00C3, 0x007E, 0x0000, 0x0000, 0x0000},
    /* S */ {0x0000, 0x003F, 0x0070, 0x0060, 0x0070, 0x0038, 0x001C, 0x000E, 0x0007, 0x0003, 0x0003, 0x007E, 0x0000, 0x0000, 0x0000},
    /* T */ {0x0000, 0x003F, 0x000C, 0x000C, 0x000C, 0x000C, 0x000C, 0x000C, 0x000C, 0x000C, 0x000C, 0x000C, 0x0000, 0x0000, 0x0000},
    /* V */ {0x0000, 0x0042, 0x0063, 0x0063, 0x0063, 0x0063, 0x0063, 0x0066, 0x0036, 0x0036, 0x003C, 0x001C, 0x0000, 0x0000, 0x0000},
    /* W */ {0x0000, 0x0333, 0x0333, 0x0333, 0x0333, 0x0333, 0x0333, 0x0333, 0x0132, 0x01FE, 0x00CC, 0x00CC, 0x0000, 0x0000, 0x0000},
    /* a */ {0x0000, 0x0000, 0x0000, 0x003E, 0x0003, 0x0003, 0x0003, 0x003F, 0x0063, 0x0063, 0x0063, 0x003D, 0x0000, 0x0000, 0x0000},
    /* b */ {0x0060, 0x0060, 0x0060, 0x007E, 0x0063, 0x0063, 0x0063, 0x0063, 0x0063, 0x0063, 0x0063, 0x005E, 0x0000, 0x0000, 0x0000},
    /* c */ {0x0000, 0x0000, 0x0000, 0x000F, 0x0018, 0x0018, 0x0018, 0x0018, 0x0018, 0x0018, 0x0018, 0x000F, 0x0000, 0x0000, 0x0000},
    /* d */ {0x0003, 0x0003, 0x0003, 0x003F, 0x0077, 0x0063, 0x0063, 0x0063, 0x0063, 0x0063, 0x0063, 0x003D, 0x0000, 0x0000, 0x0000},
    /* e */ {0x0000, 0x0000, 0x0000, 0x003E, 0x0063, 0x0063, 0x0063, 0x007F, 0x0060, 0x0060, 0x0060, 0x003F, 0x0000, 0x0000, 0x0000},
    /* f */ {0x0007, 0x000C, 0x000C, 0x001F, 0x000C, 0x000C, 0x000C, 0x000C, 0x000C, 0x000C, 0x000C, 0x000C, 0x0000, 0x0000, 0x0000},
    /* g */ {0x0000, 0x0000, 0x0000, 0x003C, 0x0063, 0x0063, 0x0063, 0x0063, 0x0063, 0x0063, 0x0063, 0x003F, 0x0003, 0x0003, 0x003E},
    /* h */ {0x0060, 0x0060, 0x0060, 0x007E, 0x0063, 0x0063, 0x0063, 0x0063, 0x0063, 0x0063, 0x0063, 0x0063, 0x0000, 0x0000, 0x0000},
    /* i */ {0x0003, 0x0003, 0x0000, 0x0001, 0x0003, 0x0003, 0x0003, 0x0003, 0x0003, 0x0003, 0x0003, 0x0003, 0x0000, 0x0000, 0x0000},
    /* k */ {0x0060, 0x0060, 0x0060, 0x0063, 0x0066, 0x006C, 0x0078, 0x0078, 0x006C, 0x0066, 0x0063, 0x0063, 0x0000, 0x0000, 0x0000},
    /* l */ {0x0003, 0x0003, 0x0003, 0x0003, 0x0003, 0x0003, 0x0003, 0x0003, 0x0003, 0x0003, 0x0003, 0x0003, 0x0000, 0x0000, 0x0000},
    /* m */ {0x0000, 0x0000, 0x0000, 0x00CC, 0x0336, 0x0333, 0x0333, 0x0333, 0x0333, 0x0333, 0x0333, 0x0333, 0x0000, 0x0000, 0x0000},
    /* n */ {0x0000, 0x0000, 0x0000, 0x001C, 0x0066, 0x0063, 0x0063, 0x0063, 0x0063, 0x0063, 0x0063, 0x0063, 0x0000, 0x0000, 0x0000},
    /* o */ {0x0000, 0x0000, 0x0000, 0x003C, 0x0066, 0x0063, 0x0063, 0x0063, 0x0063, 0x0063, 0x0063, 0x003E, 0x0000, 0x0000, 0x0000},
    /* p */ {0x0000, 0x0000, 0x0000, 0x001E, 0x0063, 0x0063, 0x0063, 0x0063, 0x0063, 0x0063, 0x0063, 0x007E, 0x0060, 0x0060, 0x0060},
    /* q */ {0x0000, 0x0000, 0x0000, 0x0038, 0x0063, 0x0063, 0x0063, 0x0063, 0x0063, 0x0063, 0x0063, 0x003F, 0x0003, 0x0003, 0x0003},
    /* r */ {0x0000, 0x0000, 0x0000, 0x000B, 0x000F, 0x000C, 0x000C, 0x000C, 0x000C, 0x000C, 0x000C, 0x000C, 0x0000, 0x0000, 0x0000},
    /* s */ {0x0000, 0x0000, 0x0000, 0x001F, 0x0030, 0x0038, 0x001C, 0x000E, 0x0007, 0x0003, 0x0003, 0x003E, 0x0000, 0x0000, 0x0000},
    /* t */ {0x0000, 0x0004, 0x000C, 0x001F, 0x000C, 0x000C, 0x000C, 0x000C, 0x000C, 0x000C, 0x000C, 0x0007, 0x0000, 0x0000, 0x0000},
    /* u */ {0x0000, 0x0000, 0x0000, 0x0063, 0x0063, 0x0063, 0x0063, 0x0063, 0x0063, 0x0063, 0x0063, 0x003D, 0x0000, 0x0000, 0x0000},
    /* v */ {0x0000, 0x0000, 0x0000, 0x0021, 0x0063, 0x0063, 0x0063, 0x0033, 0x0032, 0x0032, 0x001E, 0x000C, 0x0000, 0x0000, 0x0000},
    /* w */ {0x0000, 0x0000, 0x0000, 0x0333, 0x0333, 0x0333, 0x0333, 0x0333, 0x0333, 0x0333, 0x01FE, 0x00CC, 0x0000, 0x0000, 0x0000},
    /* x */ {0x0000, 0x0000, 0x0000, 0x0063, 0x0063, 0x0036, 0x001C, 0x001C, 0x001C, 0x0036, 0x0063, 0x0063, 0x0000, 0x0000, 0x0000},
    /* y */ {0x0000, 0x0000, 0x0000, 0x0063, 0x0063, 0x0063, 0x0063, 0x0036, 0x0036, 0x0036, 0x001C, 0x0018, 0x0018, 0x0070, 0x0060},
    /* z */ {0x0000, 0x0000, 0x0000, 0x007F, 0x0003, 0x0006, 0x000C, 0x0018, 0x0030, 0x0060, 0x0060, 0x007F, 0x0000, 0x0000, 0x0000},
};
